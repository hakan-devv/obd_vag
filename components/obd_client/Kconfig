## components/obd_client/Kconfig
```kconfig
menu "OBD client"

config OBD_LOOPBACK_ECU_SIMULATOR
    bool "Internal OBD-II ECU simulator (MCP2515 loopback)"
    default n
    help
        Run the OBD request scheduler and an internal fake ECU using the MCP2515
        hardware loopback mode. The 0x7DF request and 0x7E8 response are looped
        back internally and do not drive the physical CAN bus. This tests the
        CAN controller TX/RX path, OBD PID parser, and display without a vehicle
        or a second CAN transceiver. It does not validate physical CAN wiring,
        transceiver operation, or vehicle compatibility.

endmenu
```

## main/Kconfig.projbuild
```kconfig
menu "OBD VAG CAN"

    choice OBD_CAN_BITRATE
        prompt "CAN bitrate"
        default OBD_CAN_BITRATE_500K
        help
            This setting is independent of the CAN identifier width.

        config OBD_CAN_BITRATE_250K
            bool "250 kbit/s"

        config OBD_CAN_BITRATE_500K
            bool "500 kbit/s"
    endchoice

    choice OBD_CAN_ID_FORMAT
        prompt "CAN identifier width"
        default OBD_CAN_ID_STANDARD
        help
            Select 11-bit standard or 29-bit extended CAN identifiers independently
            from the bitrate. Passive receive still reports both frame formats.

        config OBD_CAN_ID_STANDARD
            bool "11-bit standard"

        config OBD_CAN_ID_EXTENDED
            bool "29-bit extended"
    endchoice

    config OBD_MCP2515_SPI_HZ
        int "MCP2515 SPI clock (Hz)"
        range 100000 5000000
        default 1000000
        help
            Start at 1 MHz. Do not exceed 5 MHz.

    config OBD_RUN_CAN_SELF_TEST
        bool "Run MCP2515 loopback self-test at boot"
        default y
        help
            Runs the internal loopback test. It does not send frames onto the vehicle bus.

    config OBD_RUN_PROTOCOL_TESTS
        bool "Run ISO-TP and OBD decoder unit tests at boot"
        default n
        help
            Builds and runs protocol tests instead of starting the CAN application.

    config OBD_ACTIVE_TX
        bool "Enable active OBD-II requests after CAN discovery"
        default n
        help
            Disabled by default. When enabled, the firmware first scans supported
            bitrate and identifier-width candidates in Listen-Only mode. It sends
            Mode 01 PID 00 only after observing valid CAN traffic, and accepts a
            candidate only after a matching positive 41 00 response. Enable
            deliberately only on a bus where diagnostic requests are permitted.

endmenu
```
